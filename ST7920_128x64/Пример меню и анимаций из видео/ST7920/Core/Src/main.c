/* USER CODE BEGIN Header */
/**
 ******************************************************************************
 * @file           : main.c
 * @brief          : Main program body
 ******************************************************************************
 * @attention
 *
 * <h2><center>&copy; Copyright (c) 2020 STMicroelectronics.
 * All rights reserved.</center></h2>
 *
 * This software component is licensed by ST under BSD 3-Clause license,
 * the "License"; You may not use this file except in compliance with the
 * License. You may obtain a copy of the License at:
 *                        opensource.org/licenses/BSD-3-Clause
 *
 ******************************************************************************
 */
/* USER CODE END Header */
/* Includes ------------------------------------------------------------------*/
#include "main.h"

/* Private includes ----------------------------------------------------------*/
/* USER CODE BEGIN Includes */
#include <stdio.h>
#include <stdbool.h>
#include "ST7920_lib.h"

extern char tx_buffer[128];
extern uint8_t Frame_buffer[1024]; //Буфер кадра.
extern char solderingiron[1024]; //Демонстрационное Logo

bool flag_led = 0;
bool update = 1;

uint8_t page = 0;
uint32_t counter = 0;

const unsigned char photo[] = { 0xFF, 0xFF, 0xFF, 0xFF, 0xFF, 0xFF, 0xFF, 0xFF, 0xFF, 0xFF, 0xFF, 0xFF, 0xFB, 0xFF, 0xFF, 0xFF, 0xFD, 0xFD, 0x3D, 0x0F, 0x0F,
		0x07, 0x06, 0x07, 0x06, 0x07, 0x07, 0x07, 0x06, 0x07, 0x07, 0x03, 0x03, 0x03, 0x03, 0x03, 0x03, 0x03, 0x07, 0x07, 0x07, 0x07, 0x0F, 0x0F, 0x07, 0x0F,
		0x0F, 0x0F, 0x0F, 0x0F, 0x0F, 0x07, 0x07, 0x0F, 0x07, 0x07, 0x07, 0x07, 0x07, 0x07, 0x07, 0xF7, 0xFF, 0xFF, 0xFF, 0xFF, 0xFF, 0x7F, 0x1F, 0x0F, 0x07,
		0x03, 0x03, 0x01, 0x01, 0x00, 0x00, 0x00, 0x00, 0x00, 0x00, 0x00, 0x00, 0x00, 0x00, 0x00, 0x00, 0x00, 0x00, 0x00, 0x00, 0x00, 0x00, 0x00, 0x00, 0x02,
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		0xFF, 0xFF, 0xFF };

float counter_float = 0;
unsigned long Time_page, Time_update, Time_counter;

/* USER CODE END Includes */

/* Private typedef -----------------------------------------------------------*/
/* USER CODE BEGIN PTD */

/* USER CODE END PTD */

/* Private define ------------------------------------------------------------*/
/* USER CODE BEGIN PD */
/* USER CODE END PD */

/* Private macro -------------------------------------------------------------*/
/* USER CODE BEGIN PM */

/* USER CODE END PM */

/* Private variables ---------------------------------------------------------*/
SPI_HandleTypeDef hspi1;
DMA_HandleTypeDef hdma_spi1_tx;

TIM_HandleTypeDef htim1;

/* USER CODE BEGIN PV */

/* USER CODE END PV */

/* Private function prototypes -----------------------------------------------*/
void SystemClock_Config(void);
static void MX_GPIO_Init(void);
static void MX_DMA_Init(void);
static void MX_SPI1_Init(void);
static void MX_TIM1_Init(void);
/* USER CODE BEGIN PFP */

/* USER CODE END PFP */

/* Private user code ---------------------------------------------------------*/
/* USER CODE BEGIN 0 */

int _write(int file, uint8_t *ptr, int len) {

	for (int DataIdx = 0; DataIdx < len; DataIdx++) {
		ITM_SendChar(*ptr++);
	}
	return len;
}

/* USER CODE END 0 */

/**
 * @brief  The application entry point.
 * @retval int
 */
int main(void) {
	/* USER CODE BEGIN 1 */

	/* USER CODE END 1 */

	/* MCU Configuration--------------------------------------------------------*/

	/* Reset of all peripherals, Initializes the Flash interface and the Systick. */

	HAL_Init();

	/* USER CODE BEGIN Init */

	/* USER CODE END Init */

	/* Configure the system clock */
	SystemClock_Config();

	/* USER CODE BEGIN SysInit */

	/* USER CODE END SysInit */

	/* Initialize all configured peripherals */
	MX_GPIO_Init();
	MX_DMA_Init();
	MX_SPI1_Init();
	MX_TIM1_Init();
	/* USER CODE BEGIN 2 */
	//HAL_TIM_Base_Start_IT(&htim1);
	HAL_TIM_Base_Start_IT(&htim1);
	HAL_Delay(100);
	ST7920_Init();
	ST7920_Graphic_mode(1);
	ST7920_logo_demonstration();
	ST7920_Clean_Frame_buffer();
	ST7920_Update();
	ST7920_Inversion(0, 128);
	Time_page = HAL_GetTick();
	/* USER CODE END 2 */

	/* Infinite loop */
	/* USER CODE BEGIN WHILE */
	while (1) {
		/* USER CODE END WHILE */

		/* USER CODE BEGIN 3 */

		if (HAL_GetTick() - Time_counter > 50) {
			Time_counter = HAL_GetTick();
			counter++;
		}

		if (HAL_GetTick() - Time_page > 3000) {
			Time_page = HAL_GetTick();
			//ST7920_Clean();
			ST7920_Clean_Frame_buffer();
			ST7920_Inversion(0, 128);
			page++;
			if (page > 4) {
				page = 0;
			}
		}

		if (page == 0) {

			sprintf(tx_buffer, "Основное меню");
			ST7920_Decode_UTF8(25, 0, 1, tx_buffer);

			sprintf(tx_buffer, "Оплата программисту:");
			ST7920_Decode_UTF8(0, 2, 0, tx_buffer);
			sprintf(tx_buffer, "Счетчик:%ld руб.", counter);
			ST7920_Decode_UTF8(0, 4, 0, tx_buffer);
			update = 1;
		}

		else if (page == 1) {
			sprintf(tx_buffer, "Настройки");
			ST7920_Decode_UTF8(35, 0, 1, tx_buffer);

			sprintf(tx_buffer, ">Обогрев:вкл");
			ST7920_Decode_UTF8(0, 2, 0, tx_buffer);
			sprintf(tx_buffer, "Увлажнитель:вкл");
			ST7920_Decode_UTF8(0, 3, 0, tx_buffer);
			for (uint8_t i = 0; i < 128; i++) {
				ST7920_Draw_pixel(i, 40);
			}
			sprintf(tx_buffer, "Уст.температура:25°C");
			ST7920_Decode_UTF8(0, 6, 0, tx_buffer);
			sprintf(tx_buffer, "Уст.влажность:60%%");
			ST7920_Decode_UTF8(0, 7, 0, tx_buffer);
			update = 1;
		}

		else if (page == 2) {
			sprintf(tx_buffer, "Шрифт 5x7");
			ST7920_Decode_UTF8(35, 0, 1, tx_buffer);
			sprintf(tx_buffer, "Съешь ещё этих мягких");
			ST7920_Decode_UTF8(0, 2, 0, tx_buffer);
			sprintf(tx_buffer, "французских булок,");
			ST7920_Decode_UTF8(0, 3, 0, tx_buffer);
			sprintf(tx_buffer, "да выпей чаю.");
			ST7920_Decode_UTF8(0, 4, 0, tx_buffer);
			sprintf(tx_buffer, "1234567890");
			ST7920_Decode_UTF8(0, 5, 0, tx_buffer);
			update = 1;

		}

		else if (page == 3) {
			ST7920_Draw_bitmap(photo);
			update = 0;

		} else if (page == 4) {
			for (uint8_t i = 0; i < 10; i++) {
				ST7920_Clean_Frame_buffer();
				ST7920_Draw_line(0, 0, 127, 63);
				ST7920_Draw_line(0, 63, 127, 0);
				ST7920_Draw_rectangle(80, 5, 30, 20);
				ST7920_Draw_rectangle_filled(i, i, 50, 10);
				ST7920_Draw_circle(70 + i, 50, 10);
				ST7920_Draw_circle_filled(50, 25, 10 + i);
				ST7920_Draw_triangle(0, 63, 50 + i, 0, 127 - i, 20);
				ST7920_Draw_triangle_filled(40, 10 + i, 75, 20, 100, 40);
				ST7920_Update();
			}
			for (uint8_t i = 10; i > 0; i--) {
				ST7920_Clean_Frame_buffer();
				ST7920_Draw_line(0, 0, 127, 63);
				ST7920_Draw_line(0, 63, 127, 0);
				ST7920_Draw_rectangle(80, 5, 30, 20);
				ST7920_Draw_rectangle_filled(i, i, 50, 10);
				ST7920_Draw_circle(70 + i, 50, 10);
				ST7920_Draw_circle_filled(50, 25, 10 + i);
				ST7920_Draw_triangle(0, 63, 50 + i, 0, 127 - i, 20);
				ST7920_Draw_triangle_filled(40, 10 + i, 75, 20, 100, 40);
				ST7920_Update();
			}
			for (uint8_t i = 0; i < 20; i++) {
				ST7920_Clean_Frame_buffer();
				ST7920_Draw_line(0, 0, 127, 63);
				ST7920_Draw_line(0, 63, 127, 0);
				ST7920_Draw_rectangle(80, 5, 30, 20);
				ST7920_Draw_rectangle_filled(i, i, 50, 10);
				ST7920_Draw_circle(70 + i, 50, 10);
				ST7920_Draw_circle_filled(50, 25, 10 + i);
				ST7920_Draw_triangle(0, 63, 50 + i, 0, 127 - i, 20);
				ST7920_Draw_triangle_filled(40, 10 + i, 75, 20, 100, 40);
				ST7920_Update();
			}
			for (uint8_t i = 20; i > 0; i--) {
				ST7920_Clean_Frame_buffer();
				ST7920_Draw_line(0, 0, 127, 63);
				ST7920_Draw_line(0, 63, 127, 0);
				ST7920_Draw_rectangle(80, 5, 30, 20);
				ST7920_Draw_rectangle_filled(i, i, 50, 10);
				ST7920_Draw_circle(70 + i, 50, 10);
				ST7920_Draw_circle_filled(50, 25, 10 + i);
				ST7920_Draw_triangle(0, 63, 50 + i, 0, 127 - i, 20);
				ST7920_Draw_triangle_filled(40, 10 + i, 75, 20, 100, 40);
				ST7920_Update();
			}
		}

		if (HAL_GetTick() - Time_update >= 300) {
			Time_update = HAL_GetTick();
			if (update) {
				ST7920_Update();
			}
		}

	}
	/* USER CODE END 3 */
}

/**
 * @brief System Clock Configuration
 * @retval None
 */
void SystemClock_Config(void) {
	RCC_OscInitTypeDef RCC_OscInitStruct = { 0 };
	RCC_ClkInitTypeDef RCC_ClkInitStruct = { 0 };

	/** Initializes the RCC Oscillators according to the specified parameters
	 * in the RCC_OscInitTypeDef structure.
	 */
	RCC_OscInitStruct.OscillatorType = RCC_OSCILLATORTYPE_HSE;
	RCC_OscInitStruct.HSEState = RCC_HSE_ON;
	RCC_OscInitStruct.HSEPredivValue = RCC_HSE_PREDIV_DIV1;
	RCC_OscInitStruct.HSIState = RCC_HSI_ON;
	RCC_OscInitStruct.PLL.PLLState = RCC_PLL_ON;
	RCC_OscInitStruct.PLL.PLLSource = RCC_PLLSOURCE_HSE;
	RCC_OscInitStruct.PLL.PLLMUL = RCC_PLL_MUL9;
	if (HAL_RCC_OscConfig(&RCC_OscInitStruct) != HAL_OK) {
		Error_Handler();
	}
	/** Initializes the CPU, AHB and APB buses clocks
	 */
	RCC_ClkInitStruct.ClockType = RCC_CLOCKTYPE_HCLK | RCC_CLOCKTYPE_SYSCLK | RCC_CLOCKTYPE_PCLK1 | RCC_CLOCKTYPE_PCLK2;
	RCC_ClkInitStruct.SYSCLKSource = RCC_SYSCLKSOURCE_PLLCLK;
	RCC_ClkInitStruct.AHBCLKDivider = RCC_SYSCLK_DIV1;
	RCC_ClkInitStruct.APB1CLKDivider = RCC_HCLK_DIV2;
	RCC_ClkInitStruct.APB2CLKDivider = RCC_HCLK_DIV1;

	if (HAL_RCC_ClockConfig(&RCC_ClkInitStruct, FLASH_LATENCY_2) != HAL_OK) {
		Error_Handler();
	}
}

/**
 * @brief SPI1 Initialization Function
 * @param None
 * @retval None
 */
static void MX_SPI1_Init(void) {

	/* USER CODE BEGIN SPI1_Init 0 */

	/* USER CODE END SPI1_Init 0 */

	/* USER CODE BEGIN SPI1_Init 1 */

	/* USER CODE END SPI1_Init 1 */
	/* SPI1 parameter configuration*/
	hspi1.Instance = SPI1;
	hspi1.Init.Mode = SPI_MODE_MASTER;
	hspi1.Init.Direction = SPI_DIRECTION_2LINES;
	hspi1.Init.DataSize = SPI_DATASIZE_8BIT;
	hspi1.Init.CLKPolarity = SPI_POLARITY_HIGH;
	hspi1.Init.CLKPhase = SPI_PHASE_2EDGE;
	hspi1.Init.NSS = SPI_NSS_SOFT;
	hspi1.Init.BaudRatePrescaler = SPI_BAUDRATEPRESCALER_4;
	hspi1.Init.FirstBit = SPI_FIRSTBIT_MSB;
	hspi1.Init.TIMode = SPI_TIMODE_DISABLE;
	hspi1.Init.CRCCalculation = SPI_CRCCALCULATION_DISABLE;
	hspi1.Init.CRCPolynomial = 10;
	if (HAL_SPI_Init(&hspi1) != HAL_OK) {
		Error_Handler();
	}
	/* USER CODE BEGIN SPI1_Init 2 */

	/* USER CODE END SPI1_Init 2 */

}

/**
 * @brief TIM1 Initialization Function
 * @param None
 * @retval None
 */
static void MX_TIM1_Init(void) {

	/* USER CODE BEGIN TIM1_Init 0 */

	/* USER CODE END TIM1_Init 0 */

	TIM_ClockConfigTypeDef sClockSourceConfig = { 0 };
	TIM_MasterConfigTypeDef sMasterConfig = { 0 };

	/* USER CODE BEGIN TIM1_Init 1 */

	/* USER CODE END TIM1_Init 1 */
	htim1.Instance = TIM1;
	htim1.Init.Prescaler = 719;
	htim1.Init.CounterMode = TIM_COUNTERMODE_UP;
	htim1.Init.Period = 3000;
	htim1.Init.ClockDivision = TIM_CLOCKDIVISION_DIV1;
	htim1.Init.RepetitionCounter = 0;
	htim1.Init.AutoReloadPreload = TIM_AUTORELOAD_PRELOAD_DISABLE;
	if (HAL_TIM_Base_Init(&htim1) != HAL_OK) {
		Error_Handler();
	}
	sClockSourceConfig.ClockSource = TIM_CLOCKSOURCE_INTERNAL;
	if (HAL_TIM_ConfigClockSource(&htim1, &sClockSourceConfig) != HAL_OK) {
		Error_Handler();
	}
	sMasterConfig.MasterOutputTrigger = TIM_TRGO_RESET;
	sMasterConfig.MasterSlaveMode = TIM_MASTERSLAVEMODE_DISABLE;
	if (HAL_TIMEx_MasterConfigSynchronization(&htim1, &sMasterConfig) != HAL_OK) {
		Error_Handler();
	}
	/* USER CODE BEGIN TIM1_Init 2 */

	/* USER CODE END TIM1_Init 2 */

}

/**
 * Enable DMA controller clock
 */
static void MX_DMA_Init(void) {

	/* DMA controller clock enable */
	__HAL_RCC_DMA1_CLK_ENABLE();

	/* DMA interrupt init */
	/* DMA1_Channel3_IRQn interrupt configuration */
	HAL_NVIC_SetPriority(DMA1_Channel3_IRQn, 0, 0);
	HAL_NVIC_EnableIRQ(DMA1_Channel3_IRQn);

}

/**
 * @brief GPIO Initialization Function
 * @param None
 * @retval None
 */
static void MX_GPIO_Init(void) {
	GPIO_InitTypeDef GPIO_InitStruct = { 0 };

	/* GPIO Ports Clock Enable */
	__HAL_RCC_GPIOC_CLK_ENABLE();
	__HAL_RCC_GPIOD_CLK_ENABLE();
	__HAL_RCC_GPIOA_CLK_ENABLE();
	__HAL_RCC_GPIOB_CLK_ENABLE();

	/*Configure GPIO pin Output Level */
	HAL_GPIO_WritePin(LED_GPIO_Port, LED_Pin, GPIO_PIN_RESET);

	/*Configure GPIO pin Output Level */
	HAL_GPIO_WritePin(GPIOA, CS_Pin | RST_Pin, GPIO_PIN_RESET);

	/*Configure GPIO pin : LED_Pin */
	GPIO_InitStruct.Pin = LED_Pin;
	GPIO_InitStruct.Mode = GPIO_MODE_OUTPUT_PP;
	GPIO_InitStruct.Pull = GPIO_NOPULL;
	GPIO_InitStruct.Speed = GPIO_SPEED_FREQ_LOW;
	HAL_GPIO_Init(LED_GPIO_Port, &GPIO_InitStruct);

	/*Configure GPIO pins : CS_Pin RST_Pin */
	GPIO_InitStruct.Pin = CS_Pin | RST_Pin;
	GPIO_InitStruct.Mode = GPIO_MODE_OUTPUT_PP;
	GPIO_InitStruct.Pull = GPIO_NOPULL;
	GPIO_InitStruct.Speed = GPIO_SPEED_FREQ_LOW;
	HAL_GPIO_Init(GPIOA, &GPIO_InitStruct);

}

/* USER CODE BEGIN 4 */

/* USER CODE END 4 */

/**
 * @brief  This function is executed in case of error occurrence.
 * @retval None
 */
void Error_Handler(void) {
	/* USER CODE BEGIN Error_Handler_Debug */
	/* User can add his own implementation to report the HAL error return state */
	__disable_irq();
	while (1) {
	}
	/* USER CODE END Error_Handler_Debug */
}

#ifdef  USE_FULL_ASSERT
/**
  * @brief  Reports the name of the source file and the source line number
  *         where the assert_param error has occurred.
  * @param  file: pointer to the source file name
  * @param  line: assert_param error line source number
  * @retval None
  */
void assert_failed(uint8_t *file, uint32_t line)
{
  /* USER CODE BEGIN 6 */
  /* User can add his own implementation to report the file name and line number,
     ex: printf("Wrong parameters value: file %s on line %d\r\n", file, line) */
  /* USER CODE END 6 */
}
#endif /* USE_FULL_ASSERT */

/************************ (C) COPYRIGHT STMicroelectronics *****END OF FILE****/
