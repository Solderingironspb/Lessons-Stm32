/*
 * GMG12864_lib.c
 *
 *  Версия 1.1.(Общая графическая библиотека Волкова Олега)
 *  Переделан вывод символов на дисплей. В версии 1.1. имеется возможность вывода текста в любой точке по x и y.
 *
 *  Created on: Aug 16, 2021
 *      Author: Oleg Volkov
 *
 *  YouTube: https://www.youtube.com/channel/UCzZKTNVpcMSALU57G1THoVw
 *  GitHub: https://github.com/Solderingironspb/Lessons-Stm32/blob/master/README.md
 *  Группа ВК: https://vk.com/solderingiron.stm32
 *
 *  Кодировка UTF-8 Basic Latin: https://www.utf8-chartable.de/unicode-utf8-table.pl
 *  Кодировка UTF-8 Cyrillic: https://www.utf8-chartable.de/unicode-utf8-table.pl?start=1024&names=-&unicodeinhtml=hex
 *  Программа для конвертации изображения.bmp в bitmap: http://en.radzio.dxp.pl/bitmap_converter/
 */

#include "GMG12864_lib.h"

/*-----------------------------------Настройки----------------------------------*/

extern SPI_HandleTypeDef hspi1; //Используемая шина spi

char tx_buffer[128] = { 0, }; //Буфер для отправки текста на дисплей
uint8_t Frame_buffer[1024] = { 0, }; //Буфер кадра
uint8_t GMG12864_width = 128; //Ширина дисплея в пикселях
uint8_t GMG12864_height = 64; //Высота дисплея в пикселях

//Для работы отрисовки графика:
uint8_t cnt = 0; //счетчик накопления значений в окне графика
const uint8_t size_array = 100; //размер массива. В нашем случае ширина 100 точек(График 100*50 пикселей)
uint8_t arr[100] = { 0, }; //значения на графике. Заполняются в определенный момент времени(каждый шаг сдвига графика влево)
bool array_is_full = 0; //значения заполнили массив, можно сдвигать график влево

/*-----------------------------------Настройки----------------------------------*/

/*------------------------------Добавить в main.c-------------------------------*/
//extern char tx_buffer[128]; //Буфер для отправки текста на дисплей
//extern uint8_t Frame_buffer[1024]; //Буфер кадра
//Если планируется выводить один график, то:
//extern uint8_t cnt;//счетчик накопления значений в окне графика
//extern const uint8_t size_array;//размер массива. В нашем случае ширина 100 точек(График 100*50 пикселей)
//extern uint8_t arr[100];//значения на графике. Заполняются в определенный момент времени(каждый шаг сдвига графика влево)
//extern bool array_is_full;//значения заполнили массив, можно сдвигать график влево
/*------------------------------Добавить в main.c-------------------------------*/

/*-----------------------------------Шрифт 3*5----------------------------------*/
const uint8_t Font_3x5[] = { 0x00, 0x00, 0x00, //0/ --> space     20
		0x17, 0x00, 0x00, //1/ --> !         21
		0x03, 0x00, 0x03, //2/ --> "         22 и т.д.
		0xFF, 0x0A, 0xFF, //3/ --> #
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		0x03, 0x03, 0x00, //161/ --> °
		};
/*-----------------------------------Шрифт 3*5----------------------------------*/

/*-----------------------------------Шрифт 5*7----------------------------------*/
const uint8_t Font_5x7[] = { 0x00, 0x00, 0x00, 0x00, 0x00, //0/ --> space     20
		0x00, 0x4F, 0x00, 0x00, 0x00, //1/ --> !         21
		0x07, 0x00, 0x07, 0x00, 0x00, //2/ --> "         22 и т.д.
		0x14, 0x7F, 0x14, 0x7F, 0x14, //3/ --> #
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		0x00, 0x06, 0x09, 0x09, 0x06, //161/ --> °
		};

/*-----------------------------------Шрифт 5*7----------------------------------*/

/*================= Демонстрационное лого. Можно вырезать. =====================*/
/*-----------------------------Демонстрационное Logo----------------------------*/
const char solderingiron[] = { 0xC0, 0xE0, 0x30, 0x30, 0x30, 0x30, 0x60, 0x20, 0x00, 0x00, 0x00, 0x00, 0x00, 0x00, 0x00, 0x00, 0x00, 0x00, 0x00, 0x00, 0x00,
		0xF8, 0xF8, 0x00, 0x00, 0x00, 0x00, 0x00, 0x00, 0x00, 0xF8, 0xF8, 0x00, 0x00, 0x00, 0x00, 0x00, 0x00, 0x00, 0x00, 0x00, 0x00, 0x00, 0x00, 0x00, 0x00,
		0x00, 0x00, 0x00, 0x00, 0x30, 0x30, 0x00, 0x00, 0x00, 0x00, 0x00, 0x00, 0x00, 0x00, 0x00, 0x00, 0x00, 0x00, 0x00, 0x00, 0x00, 0x00, 0x00, 0x00, 0x00,
		0x00, 0x00, 0x00, 0x00, 0x00, 0x00, 0x00, 0x00, 0x00, 0x00, 0x00, 0x00, 0x30, 0x30, 0x00, 0x00, 0x00, 0x00, 0x00, 0x00, 0x00, 0x00, 0x00, 0x00, 0x00,
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		0x08, 0x08, 0x08, 0x08, 0x09, 0x0B, 0x0B, 0x0B, 0x0B, 0x09, 0x08, 0x08, 0x08, 0x08, 0x0B, 0x0B, 0x08, 0x08, 0x08, 0x08, 0x08, 0x0B, 0x0B };
/*-----------------------------Демонстрационное Logo----------------------------*/

/*---------------Вывод стартового демонстрационного лого------------------------*/
void GMG12864_logo_demonstration(void) {
	GMG12864_Clean_Frame_buffer();
	for (int i = 0; i < 369; i++) {
		Frame_buffer[i + 265] = solderingiron[i];
	}
	GMG12864_Update();
	sprintf(tx_buffer, "Saint Petersburg");
	GMG12864_Decode_UTF8(16, 40, 1, 0, tx_buffer);
	sprintf(tx_buffer, "electronics lab.");
	GMG12864_Decode_UTF8(18, 48, 1, 0, tx_buffer);
	HAL_Delay(500);
	GMG12864_Update();
	HAL_Delay(3000);
	sprintf(tx_buffer, "                ");
	GMG12864_Decode_UTF8(18, 48, 1, 0, tx_buffer);
	HAL_Delay(500);
	GMG12864_Update();
	sprintf(tx_buffer, "                ");
	GMG12864_Decode_UTF8(16, 40, 1, 0, tx_buffer);
	HAL_Delay(500);
	GMG12864_Update();

	for (int i = 0; i < 369; i++) {
		Frame_buffer[i + 265] = 0x00;
	}
	GMG12864_Update();
	HAL_Delay(500);
	GMG12864_Clean_Frame_buffer();
	GMG12864_Update();
}
/*---------------Вывод стартового демонстрационного лого------------------------*/
/*================= Демонстрационное лого. Можно вырезать. =====================*/

/*----------------------Функция отправки команды на дисплей------------------------*/
static void GMG12864_Send_command(uint8_t Command) {
/// Функция отправки команды на дисплей
/// \param Command - 8 бит данных.
	DC_set();
	HAL_SPI_Transmit(&hspi1, &Command, 1, HAL_MAX_DELAY);
	while (HAL_SPI_GetState(&hspi1) != HAL_SPI_STATE_READY);
	DC_reset();
}
/*----------------------Функция отправки команды на дисплей------------------------*/

/*----------------------Функция отправки данных на дисплей------------------------*/
/// Функция отправки данных на дисплей
/// \param Data - 8 бит данных.
static void GMG12864_Send_data(uint8_t Dat) {
	HAL_SPI_Transmit(&hspi1, &Dat, 1, HAL_MAX_DELAY);
	while (HAL_SPI_GetState(&hspi1) != HAL_SPI_STATE_READY);
}
/*----------------------Функция отправки данных на дисплей------------------------*/

/*------------------------Функция очистки буфера кадра-------------------------*/
void GMG12864_Clean_Frame_buffer(void) {
/// Функция очистки буфера кадра
	memset(Frame_buffer, 0x00, sizeof(Frame_buffer));
}
/*------------------------Функция очистки буфера кадра-------------------------*/

/*-------------------------Функция инициализации дисплея--------------------------*/
void GMG12864_Init(void) {
/// Функция инициализации дисплея
	cs_set();
	RST_set();
	HAL_Delay(10);
	RST_reset();
	HAL_Delay(10);
	// Установите рабочий цикл ( 1/7 или 1/9 ) в зависимости от физического ЖК-дисплея
	GMG12864_Send_command(0xA2);
	HAL_Delay(1);
	// Установите горизонтальную и вертикальную ориентацию в известное состояние
	GMG12864_Send_command(0xA0); //ADC selection(SEG0->SEG128)
	GMG12864_Send_command(0xC8); //SHL selection(COM0->COM64)
	HAL_Delay(1);
	// делитель внутреннего резистора установлен на 7 (от 0..7)
	GMG12864_Send_command(0x20 | 0x7);    //Regulator Resistor Selection
	HAL_Delay(1);
	// управление питанием, все внутренние блоки включены	(от 0..7)
	GMG12864_Send_command(0x28 | 0x7);
	HAL_Delay(1);
	// войти в режим динамического контраста
	GMG12864_Send_command(0x81);    //Electronic Volume
	GMG12864_Send_command(18);	// Настройка контраста. Отрегулируйте на своем дисплее. У меня на 15-19 норм. Максимум 63.
	HAL_Delay(1);
	GMG12864_Send_command(0x40);
	HAL_Delay(1);
	// CMD_DISPLAY_ON  CMD_DISPLAY_OFF
	GMG12864_Send_command(0xAF);    		//Display on
	// Инвертирование экрана
	GMG12864_Send_command(0xA6); //0xA6 - nomal, 0xA7 - revers
	HAL_Delay(1);
	cs_reset();
}
/*-------------------------Функция инициализации дисплея--------------------------*/

/*------------------------Функция вывода изображения с указаием его размера-------------------------*/
void GMG12864_DrawBitmap(const uint8_t *bitmap, int8_t x, int8_t y, int8_t w, int8_t h) {
	int16_t byteWidth = (w + 7) / 8; // Bitmap scanline pad = whole byte
	uint8_t byte = 0;

	for (int16_t j = 0; j < h; j++, y++) {

		for (int16_t i = 0; i < w; i++) {

			if (i & 7) {

				byte <<= 1;
			} else {

				byte = (*(const unsigned char*) (&bitmap[j * byteWidth + i / 8]));
			}

			if (byte & 0x80) {
				GMG12864_Draw_pixel(x + i, y, 1);
			}
		}
	}
}
/*------------------------Функция вывода изображения с указаием его размера-------------------------*/

/*------------------------Функция рисования пикселя-------------------------*/
void GMG12864_Draw_pixel(int16_t x, int16_t y, uint8_t color) {

	if (x >= GMG12864_width || x < 0 || y >= GMG12864_height || y < 0) {
		return;
	} else {
		uint16_t array_pos = x + ((y / 8) * GMG12864_width);

		if (color) {
			Frame_buffer[array_pos] |= 1 << (y % 8);
		} else {
			Frame_buffer[array_pos] &= 0xFF ^ 1 << (y % 8);
		}
	}

}
/*------------------------Функция рисования пикселя-------------------------*/

/*---------------------Функция вывода буфера кадра на дисплей------------------------*/
void GMG12864_Update(void) {
	cs_set();
	for (uint8_t y = 0; y < 8; y++) {
		ST7565_SetX(0);
		ST7565_SetY((int16_t )y);
		for (uint8_t x = 0; x < 128; x++) {
			GMG12864_Send_data(Frame_buffer[x + 128 * y]);
		}
	}
	cs_reset();
}
/*---------------------Функция вывода буфера кадра на дисплей------------------------*/

/*---------------------Функция вывода символа на дисплей-----------------------------*/
void GMG12864_Print_symbol_5x7(uint8_t x, uint8_t y, uint16_t symbol, uint8_t inversion) {
/// Функция вывода символа на дисплей
	uint8_t x_start = x; //начальное положение по x
	uint8_t x_stop = x + 5; //конечное положение по x с учетом межсимвольного интервала
	for (uint8_t x = x_start; x <= x_stop; x++) {
		if (x == x_stop) { //Заполняем межсимвольные интервалы
			for (uint8_t i = 0; i <= 6; i++) { // от 0 до 6, т.к. шрифт высотой 7 пикселей
				if (0x00 & (1 << i)) {
					if (inversion) {
						GMG12864_Draw_pixel(x, y + i, 0); //Закрасить пиксель
					} else {
						GMG12864_Draw_pixel(x, y + i, 1); //Закрасить пиксель
					}
				} else {
					if (inversion) {
						GMG12864_Draw_pixel(x, y + i, 1); //Очистить пиксель
					} else {
						GMG12864_Draw_pixel(x, y + i, 0); //Очистить пиксель
					}
				}
			}
		} else { //Заполняем полезной информацией
			for (uint8_t i = 0; i <= 6; i++) { // от 0 до 6, т.к. шрифт высотой 7 пикселей
				if (Font_5x7[(symbol * 5) + x - x_start] & (1 << i)) {
					if (inversion) {
						GMG12864_Draw_pixel(x, y + i, 0); //Закрасить пиксель
					} else {
						GMG12864_Draw_pixel(x, y + i, 1); //Закрасить пиксель
					}
				} else {
					if (inversion) {
						GMG12864_Draw_pixel(x, y + i, 1); //Очистить пиксель
					} else {
						GMG12864_Draw_pixel(x, y + i, 0); //Очистить пиксель
					}
				}
			}
		}
	}
}
/*---------------------Функция вывода символа на дисплей-----------------------------*/

/*---------------------Функция вывода символа на дисплей-----------------------------*/
void GMG12864_Print_symbol_3x5(uint8_t x, uint8_t y, uint16_t symbol, uint8_t inversion) {
/// Функция вывода символа на дисплей
	uint8_t x_start = x; //начальное положение по x
	uint8_t x_stop = x + 3; //конечное положение по x с учетом межсимвольного интервала
	for (uint8_t x = x_start; x <= x_stop; x++) {
		if (x == x_stop) { //Заполняем межсимвольные интервалы
			for (uint8_t i = 0; i <= 4; i++) { // от 0 до 6, т.к. шрифт высотой 7 пикселей
				if (0x00 & (1 << i)) {
					if (inversion) {
						GMG12864_Draw_pixel(x, y + i, 0); //Закрасить пиксель
					} else {
						GMG12864_Draw_pixel(x, y + i, 1); //Закрасить пиксель
					}
				} else {
					if (inversion) {
						GMG12864_Draw_pixel(x, y + i, 1); //Очистить пиксель
					} else {
						GMG12864_Draw_pixel(x, y + i, 0); //Очистить пиксель
					}
				}
			}
		} else { //Заполняем полезной информацией
			for (uint8_t i = 0; i <= 4; i++) { // от 0 до 6, т.к. шрифт высотой 7 пикселей
				if (Font_3x5[(symbol * 3) + x - x_start] & (1 << i)) {
					if (inversion) {
						GMG12864_Draw_pixel(x, y + i, 0); //Закрасить пиксель
					} else {
						GMG12864_Draw_pixel(x, y + i, 1); //Закрасить пиксель
					}
				} else {
					if (inversion) {
						GMG12864_Draw_pixel(x, y + i, 1); //Очистить пиксель
					} else {
						GMG12864_Draw_pixel(x, y + i, 0); //Очистить пиксель
					}
				}
			}
		}
	}
}
/*---------------------Функция вывода символа на дисплей-----------------------------*/

/*----------------Функция декодирования UTF-8 в набор символов-----------------*/
void GMG12864_Decode_UTF8(uint8_t x, uint8_t y, uint8_t font, bool inversion, char *tx_buffer) {
/// Функция декодирования UTF-8 в набор символов и последующее занесение в буфер кадра
/// \param x - координата по х. От 0 до 127
/// \param y - координата по y. от 0 до 7
/// \param font - шрифт. 0 - 3x5, 1 - 5x7
	uint16_t symbol = 0;
	bool flag_block = 0;
	for (int i = 0; i < strlen(tx_buffer); i++) {
		if (tx_buffer[i] < 0xC0) { //Английский текст и символы. Если до русского текста, то [i] <0xD0. Но в font добавлен знак "°"
			if (flag_block) {
				flag_block = 0;
			} else {
				symbol = tx_buffer[i];
				if (font == font3x5) { //Если выбран шрифт размера 3x5
					if (inversion) {
						GMG12864_Print_symbol_3x5(x, y, symbol - 32, 1); //Таблица UTF-8. Basic Latin. С "пробел" до "z". Инверсия вкл.
					} else {
						GMG12864_Print_symbol_3x5(x, y, symbol - 32, 0); //Таблица UTF-8. Basic Latin. С "пробел" до "z". Инверсия выкл.
					}
					x = x + 4;
				} else if (font == font5x7) { //Если выбран шрифт размера 5x7
					if (inversion) {
						GMG12864_Print_symbol_5x7(x, y, symbol - 32, 1); //Таблица UTF-8. Basic Latin. С "пробел" до "z". Инверсия вкл.
					} else {
						GMG12864_Print_symbol_5x7(x, y, symbol - 32, 0); //Таблица UTF-8. Basic Latin. С "пробел" до "z". Инверсия выкл.
					}
					x = x + 6;
				}
			}
		}

		else { //Русский текст
			symbol = tx_buffer[i] << 8 | tx_buffer[i + 1];
			if (symbol < 0xD180 && symbol > 0xD081) {
				if (font == font3x5) { //Если выбран шрифт размера 3x5
					if (inversion) {
						GMG12864_Print_symbol_3x5(x, y, symbol - 53297, 1); //Таблица UTF-8. Кириллица. С буквы "А" до "п". Инверсия вкл.
					} else {
						GMG12864_Print_symbol_3x5(x, y, symbol - 53297, 0); //Таблица UTF-8. Кириллица. С буквы "А" до "п". Инверсия выкл.
					}
					x = x + 4;
				} else if (font == font5x7) { //Если выбран шрифт размера 5x7
					if (inversion) {
						GMG12864_Print_symbol_5x7(x, y, symbol - 53297, 1); //Таблица UTF-8. Кириллица. С буквы "А" до "п". Инверсия вкл.
					} else {
						GMG12864_Print_symbol_5x7(x, y, symbol - 53297, 0); //Таблица UTF-8. Кириллица. С буквы "А" до "п". Инверсия выкл.
					}
					x = x + 6;
				}
			} else if (symbol == 0xD081) {
				if (font == font3x5) { //Если выбран шрифт размера 3x5
					if (inversion) {
						GMG12864_Print_symbol_3x5(x, y, 159, 1); ////Таблица UTF-8. Кириллица. Буква "Ё". Инверсия вкл.
					} else {
						GMG12864_Print_symbol_3x5(x, y, 159, 0); ////Таблица UTF-8. Кириллица. Буква "Ё". Инверсия выкл.
					}
					x = x + 4;
				} else if (font == font5x7) { //Если выбран шрифт размера 5x7
					if (inversion) {
						GMG12864_Print_symbol_5x7(x, y, 159, 1); ////Таблица UTF-8. Кириллица. Буква "Ё". Инверсия вкл.
					} else {
						GMG12864_Print_symbol_5x7(x, y, 159, 0); ////Таблица UTF-8. Кириллица. Буква "Ё". Инверсия выкл.
					}
					x = x + 6;
				}
			} else if (symbol == 0xD191) {
				if (font == font3x5) { //Если выбран шрифт размера 3x5
					if (inversion) {
						GMG12864_Print_symbol_3x5(x, y, 160, 1); ////Таблица UTF-8. Кириллица. Буква "ё". Инверсия вкл.
					} else {
						GMG12864_Print_symbol_3x5(x, y, 160, 0); ////Таблица UTF-8. Кириллица. Буква "ё". Инверсия выкл.
					}
					x = x + 4;
				} else if (font == font5x7) { //Если выбран шрифт размера 5x7
					if (inversion) {
						GMG12864_Print_symbol_5x7(x, y, 160, 1); ////Таблица UTF-8. Кириллица. Буква "ё". Инверсия вкл.
					} else {
						GMG12864_Print_symbol_5x7(x, y, 160, 0); ////Таблица UTF-8. Кириллица. Буква "ё". Инверсия выкл.
					}
					x = x + 6;
				}
			} else if (symbol == 0xC2B0) {
				if (font == font3x5) { //Если выбран шрифт размера 3x5
					if (inversion) {
						GMG12864_Print_symbol_3x5(x, y, 161, 1); ////Таблица UTF-8. Basic Latin. Символ "°". Инверсия вкл.
					} else {
						GMG12864_Print_symbol_3x5(x, y, 161, 0); ////Таблица UTF-8. Basic Latin. Символ "°". Инверсия выкл.
					}
					x = x + 4;
				} else if (font == font5x7) { //Если выбран шрифт размера 5x7
					if (inversion) {
						GMG12864_Print_symbol_5x7(x, y, 161, 1); ////Таблица UTF-8. Basic Latin. Символ "°". Инверсия вкл.
					} else {
						GMG12864_Print_symbol_5x7(x, y, 161, 0); ////Таблица UTF-8. Basic Latin. Символ "°". Инверсия выкл.
					}
					x = x + 6;
				}
			}

			else {
				if (font == font3x5) { //Если выбран шрифт размера 3x5
					if (inversion) {
						GMG12864_Print_symbol_3x5(x, y, symbol - 53489, 1); //Таблица UTF-8. Кириллица. С буквы "р", начинается сдвиг. Инверсия вкл.
					} else {
						GMG12864_Print_symbol_3x5(x, y, symbol - 53489, 0); //Таблица UTF-8. Кириллица. С буквы "р", начинается сдвиг. Инверсия выкл.
					}
					x = x + 4;
				} else if (font == font5x7) { //Если выбран шрифт размера 5x7
					if (inversion) {
						GMG12864_Print_symbol_5x7(x, y, symbol - 53489, 1); //Таблица UTF-8. Кириллица. С буквы "р", начинается сдвиг. Инверсия вкл.
					} else {
						GMG12864_Print_symbol_5x7(x, y, symbol - 53489, 0); //Таблица UTF-8. Кириллица. С буквы "р", начинается сдвиг. Инверсия выкл.
					}
					x = x + 6;
				}
			}
			flag_block = 1;
		}
	}
}
/*----------------Функция декодирования UTF-8 в набор символов-----------------*/

/*---------------------Функция инверсии любого места в буфере------------------*/
void GMG12864_Inversion(uint16_t x_start, uint16_t x_end) {
/// Функция инверсии любого места в буфере
/// \param x_start - начальная точка по х от 0 до 1024
/// \param x_end - конечная точка по y от 0 до 1024
	for (; x_start < x_end; x_start++) {
		Frame_buffer[x_start] = ~(Frame_buffer[x_start]);
	}
}
/*---------------------Функция инверсии любого места в буфере------------------*/

/*----------------Функция, формирующая точку значения на графике---------------*/
uint8_t GMG12864_Value_for_Plot(int y_min, int y_max, float value) {
/// Функция, формирующая точку значения на графике
/// \param int y_min - минимальное значение по оси y
/// \param int y_max - максимальное значение по оси y
/// \param float value - значение, которое будем отображать на графике
	char text[20] = { 0, };
	uint8_t Graph_value = 0;
	if (y_max > y_min && value >= y_min && value <= y_max) {
		float y = 50.0f - (y_max + value * (-1)) * (50.0f / (y_max + y_min * (-1)));
		Graph_value = (uint8_t) y;
	} else if (value > y_max) {
		Graph_value = 50;
		sprintf(text, "   Clipping    ");
		GMG12864_Decode_UTF8(37, 26, 1, 0, text);
		GMG12864_Update();
	} else if (value < y_min) {
		Graph_value = 0;
		sprintf(text, "   Clipping    ");
		GMG12864_Decode_UTF8(37, 26, 1, 0, text);
		GMG12864_Update();
	}
	return Graph_value;
}
/*----------------Функция, формирующая точку значения на графике---------------*/

/*-------------------Работа с массивом данных---------------------*/

void GMG12864_Fill_the_array_Plot(uint8_t *counter, uint8_t *array, uint8_t size_array, uint8_t value) {
/// Функция, заполняющая массив значениями, чтоб отрисовывать график
/// \param uint8_t *counter - счетчик значений
/// \param uint8_t *array - массив, куда будем закидывать значения для отображения графика
/// \param uint8_t size_array - размер массива, куда будем закидывать значения для отображения графика
/// \param uint8_t value - подготовленное значение для графика(подготавливается при помощи ф-ии uint8_t GMG12864_Value_for_Plot(int y_min, int y_max, float value))
	if (*counter == 0) {
		array[0] = value;
	}

	if (*counter) {
		if (*counter <= size_array - 1) {
			for (int i = 0; i <= *counter; i++) {
				if (i == *counter) {
					array[0] = value;
				} else {
					array[*counter - i] = array[*counter - i - 1];
				}
			}
		} else if (*counter > size_array - 1) {
			for (int i = size_array - 1; i >= 0; i--) {
				array[i] = array[i - 1];
				if (i == 0) {
					array[i] = value;
				}
			}
		}

	}
	(*counter)++;
	if (*counter == 250) {
		*counter = 128; //Защита от переполнения, иначе график будет сбрасываться(главное чтоб разница была равна или больше кол-ву выводимых точек)
	}

}
/*-------------------Работа с массивом данных---------------------*/

/*----------------------Функция, формирующая весь график, который будет отображаться на дисплее-----------------------------*/
void GMG12864_Generate_a_Graph(uint8_t *counter, uint8_t *array, uint8_t size_array, int y_min, int y_max, uint8_t x_grid_time, uint8_t time_interval,
bool grid) {
/// Функция, формирующая весь график, который будет отображаться на дисплее
/// \param uint8_t *counter - счетчик значений
/// \param uint8_t *array - массив, куда мы закидывали значения для отображения графика
/// \param uint8_t size_array - размер массива, куда мы закидывали значения для отображения графика
/// \param int y_min - минимальное значение по оси y
/// \param int y_max - максимальное значение по оси y
/// \param uint8_t x_grid_time - размер клетки по x(Например, график обновляется раз в 100 мс, значит одна клетка по X будет 1 сек.)
/// \param uint8_t time_interval - интервал времени. 0 - сек., 1 - мин., 2 = час.
/// \param bool grid - Сетка граффика. вкл = 1. выкл = 0.

	int y_minimum = y_min;
	int y_maximum = y_max;
	if (y_min < 0) {
		y_minimum = y_minimum * (-1);
	}
	if (y_max < 0) {
		y_maximum = y_maximum * (-1);
	}
	int val_del = (y_minimum + y_maximum) / 5;
	//printf("%d\r\n", val_del);
	char text[20] = { 0, };
	GMG12864_Clean_Frame_buffer();
	sprintf(text, "%4.1d", y_min);
	GMG12864_Decode_UTF8(8, 48, 0, 0, text);
	sprintf(text, "%4.1d", (y_min + val_del));
	GMG12864_Decode_UTF8(8, 38, 0, 0, text);
	sprintf(text, "%4.1d", (y_min + val_del * 2));
	GMG12864_Decode_UTF8(8, 28, 0, 0, text);
	sprintf(text, "%4.1d", (y_min + val_del * 3));
	GMG12864_Decode_UTF8(8, 18, 0, 0, text);
	sprintf(text, "%4.1d", (y_min + val_del * 4));
	GMG12864_Decode_UTF8(8, 8, 0, 0, text);
	sprintf(text, "%4.1d", y_max);
	GMG12864_Decode_UTF8(8, 0, 0, 0, text);

	if (time_interval == 0) {
		sprintf(text, "%2.1dcек.", x_grid_time);
	} else if (time_interval == 1) {
		sprintf(text, "%2.1dмин.", x_grid_time);
	} else if (time_interval == 2) {
		sprintf(text, "%2.1dчас.", x_grid_time);
	}
	GMG12864_Decode_UTF8(53, 57, 1, 0, text);

	/*----------------Ось асцисс, ось ординат, разметка-----------------*/

	GMG12864_Draw_line(27, 50, 127, 50, 1); //ось абсцисс
	for (uint8_t i = 27; i <= 77; i = i + 10) {
		GMG12864_Draw_line(i, 51, i, 52, 1);
	}
	for (uint8_t i = 87; i <= 127; i = i + 10) {
		GMG12864_Draw_pixel(i, 51, 1);
	}

	GMG12864_Draw_line(27, 0, 27, 50, 1); //ось ординат
	for (uint8_t i = 0; i <= 50; i = i + 10) {
		GMG12864_Draw_line(25, i, 27, i, 1);
	}

	GMG12864_Draw_line(57, 53, 57, 55, 1); //Полоса по х левая
	GMG12864_Draw_line(67, 53, 67, 55, 1); //Полоса по х правая
	GMG12864_Draw_line(52, 54, 72, 54, 1); //Полоса между делениями по х
	GMG12864_Draw_line(54, 52, 54, 56, 1); //Левая стрелка на деление
	GMG12864_Draw_line(55, 53, 55, 55, 1); //Левая стрелка на деление
	GMG12864_Draw_line(69, 53, 69, 55, 1); //Правая стрелка на деление
	GMG12864_Draw_line(70, 52, 70, 56, 1); //Правая стрелка на деление
	GMG12864_Draw_line(127, 53, 127, 57, 1); //Отметка "сейчас"
	GMG12864_Draw_line(122, 55, 127, 55, 1); //Стрелка на "сейчас"
	GMG12864_Draw_line(124, 53, 124, 57, 1); //Стрелка на "сейчас"
	GMG12864_Draw_line(125, 54, 125, 56, 1); //Стрелка на "сейчас"

	/*----------------Ось асцисс, ось ординат, разметка-----------------*/

	/*--------------------------Разметка сетки-------------------------*/
	if (grid) {
		for (uint8_t y = 0; y <= 40; y = y + 10) {
			for (uint8_t x = 27; x <= 127; x = x + 2) {
				GMG12864_Draw_pixel(x, y, 1);
			}
		}

		for (uint8_t x = 27; x <= 127; x = x + 10) {
			for (uint8_t y = 0; y <= 50; y = y + 2) {
				GMG12864_Draw_pixel(x, y, 1);
			}
		}
	}
	/*--------------------------Разметка сетки-------------------------*/

	if (*counter <= size_array) {
		if (*counter == size_array) {
			array_is_full = true;
		}
	}

	if (array_is_full) {
		for (int i = 0; i < size_array - 1; i++) {
			//GMG12864_Draw_pixel(127 - i, 50 - array[i], 1); //Рисуем точками
			GMG12864_Draw_line(127 - (i + 1), 50 - array[i + 1], 127 - i, 50 - array[i], 1); //Рисуем линиями
			//GMG12864_Draw_line(127-i, 50, 127-i, 50 - array[i], 1);//Закрашиваем область

		}
	} else {
		for (int i = 0; i < *counter; i++) {
			//GMG12864_Draw_pixel(127 - i, 50 - array[i], 1); //Рисуем точками
			GMG12864_Draw_line(127 - (i + 1), 50 - array[i + 1], 127 - i, 50 - array[i], 1); //Рисуем линиями
			//GMG12864_Draw_line(127-i, 50, 127-i, 50 - array[i], 1);//Закрашиваем область

		}
	}
}
/*----------------------Функция, формирующая весь график, который будет отображаться на дисплее-----------------------------*/

/********************************РАБОТА С ГЕОМЕТРИЧЕСКИМИ ФИГУРАМИ**********************************/

void GMG12864_Draw_line(uint8_t x_start, uint8_t y_start, uint8_t x_end, uint8_t y_end, uint8_t color) {
	int dx = (x_end >= x_start) ? x_end - x_start : x_start - x_end;
	int dy = (y_end >= y_start) ? y_end - y_start : y_start - y_end;
	int sx = (x_start < x_end) ? 1 : -1;
	int sy = (y_start < y_end) ? 1 : -1;
	int err = dx - dy;

	for (;;) {
		GMG12864_Draw_pixel(x_start, y_start, color);
		if (x_start == x_end && y_start == y_end)
			break;
		int e2 = err + err;
		if (e2 > -dy) {
			err -= dy;
			x_start += sx;
		}
		if (e2 < dx) {
			err += dx;
			y_start += sy;
		}
	}
}

/*--------------------------------Вывести пустотелый прямоугольник---------------------------------*/
void GMG12864_Draw_rectangle(uint16_t x, uint16_t y, uint16_t width, uint16_t height, uint8_t color) {
/// Вывести пустотелый прямоугольник
/// \param x - начальная точка по оси "x"
/// \param y - начальная точка по оси "y"
/// \param width - ширина прямоугольника
/// \param height - высота прямоугольника

	/*Проверка ширины и высоты*/
	if ((x + width) >= GMG12864_width) {
		width = GMG12864_width - x;
	}
	if ((y + height) >= GMG12864_height) {
		height = GMG12864_height - y;
	}

	/*Рисуем линии*/
	GMG12864_Draw_line(x, y, x + width, y, color); /*Верх прямоугольника*/
	GMG12864_Draw_line(x, y + height, x + width, y + height, color); /*Низ прямоугольника*/
	GMG12864_Draw_line(x, y, x, y + height, color); /*Левая сторона прямоугольника*/
	GMG12864_Draw_line(x + width, y, x + width, y + height, color); /*Правая сторона прямоугольника*/
}
/*--------------------------------Вывести пустотелый прямоугольник---------------------------------*/

/*-------------------------------Вывести закрашенный прямоугольник---------------------------------*/
void GMG12864_Draw_rectangle_filled(uint16_t x, uint16_t y, uint16_t width, uint16_t height, uint8_t color) {
/// Вывести закрашенный прямоугольник
/// \param x - начальная точка по оси "x"
/// \param y - начальная точка по оси "y"
/// \param width - ширина прямоугольника
/// \param height - высота прямоугольника

	/*Проверка ширины и высоты*/
	if ((x + width) >= GMG12864_width) {
		width = GMG12864_width - x;
	}
	if ((y + height) >= GMG12864_height) {
		height = GMG12864_height - y;
	}

	/*Рисуем линии*/
	for (uint8_t i = 0; i <= height; i++) {
		GMG12864_Draw_line(x, y + i, x + width, y + i, color);
	}
}
/*-------------------------------Вывести закрашенный прямоугольник---------------------------------*/

/*---------------------------------Вывести пустотелую окружность-----------------------------------*/
void GMG12864_Draw_circle(uint8_t x, uint8_t y, uint8_t radius, uint8_t color) {
/// Вывести пустотелую окружность
/// \param x - точка центра окружности по оси "x"
/// \param y - точка центра окружности по оси "y"
/// \param radius - радиус окружности

	int f = 1 - (int) radius;
	int ddF_x = 1;

	int ddF_y = -2 * (int) radius;
	int x_0 = 0;

	GMG12864_Draw_pixel(x, y + radius, color);
	GMG12864_Draw_pixel(x, y - radius, color);
	GMG12864_Draw_pixel(x + radius, y, color);
	GMG12864_Draw_pixel(x - radius, y, color);

	int y_0 = radius;
	while (x_0 < y_0) {
		if (f >= 0) {
			y_0--;
			ddF_y += 2;
			f += ddF_y;
		}
		x_0++;
		ddF_x += 2;
		f += ddF_x;
		GMG12864_Draw_pixel(x + x_0, y + y_0, color);
		GMG12864_Draw_pixel(x - x_0, y + y_0, color);
		GMG12864_Draw_pixel(x + x_0, y - y_0, color);
		GMG12864_Draw_pixel(x - x_0, y - y_0, color);
		GMG12864_Draw_pixel(x + y_0, y + x_0, color);
		GMG12864_Draw_pixel(x - y_0, y + x_0, color);
		GMG12864_Draw_pixel(x + y_0, y - x_0, color);
		GMG12864_Draw_pixel(x - y_0, y - x_0, color);
	}
}
/*---------------------------------Вывести пустотелую окружность-----------------------------------*/

/*--------------------------------Вывести закрашенную окружность-----------------------------------*/
void GMG12864_Draw_circle_filled(int16_t x, int16_t y, int16_t radius, uint8_t color) {
/// Вывести закрашенную окружность
/// \param x - точка центра окружности по оси "x"
/// \param y - точка центра окружности по оси "y"
/// \param radius - радиус окружности

	int16_t f = 1 - radius;
	int16_t ddF_x = 1;
	int16_t ddF_y = -2 * radius;
	int16_t x_0 = 0;
	int16_t y_0 = radius;

	GMG12864_Draw_pixel(x, y + radius, color);
	GMG12864_Draw_pixel(x, y - radius, color);
	GMG12864_Draw_pixel(x + radius, y, color);
	GMG12864_Draw_pixel(x - radius, y, color);
	GMG12864_Draw_line(x - radius, y, x + radius, y, color);

	while (x_0 < y_0) {
		if (f >= 0) {
			y_0--;
			ddF_y += 2;
			f += ddF_y;
		}
		x_0++;
		ddF_x += 2;
		f += ddF_x;

		GMG12864_Draw_line(x - x_0, y + y_0, x + x_0, y + y_0, color);
		GMG12864_Draw_line(x + x_0, y - y_0, x - x_0, y - y_0, color);
		GMG12864_Draw_line(x + y_0, y + x_0, x - y_0, y + x_0, color);
		GMG12864_Draw_line(x + y_0, y - x_0, x - y_0, y - x_0, color);
	}
}
/*--------------------------------Вывести закрашенную окружность-----------------------------------*/

/*-----------------------------------Вывести пустотелый треугольник--------------------------------*/
void GMG12864_Draw_triangle(uint16_t x1, uint16_t y1, uint16_t x2, uint16_t y2, uint16_t x3, uint16_t y3, uint8_t color) {
/// Вывести пустотелый треугольник
/// \param x_1 - первая точка треугольника. Координата по оси "x"
/// \param y_1 - первая точка треугольника. Координата по оси "y"
/// \param x_2 - вторая точка треугольника. Координата по оси "x"
/// \param y_2 - вторая точка треугольника. Координата по оси "y"
/// \param x_3 - третья точка треугольника. Координата по оси "x"
/// \param y_3 - третья точка треугольника. Координата по оси "y"

	GMG12864_Draw_line(x1, y1, x2, y2, color);
	GMG12864_Draw_line(x2, y2, x3, y3, color);
	GMG12864_Draw_line(x3, y3, x1, y1, color);
}
/*-----------------------------------Вывести пустотелый треугольник--------------------------------*/

/*----------------------------------Вывести закрашенный треугольник--------------------------------*/
void GMG12864_Draw_triangle_filled(uint16_t x1, uint16_t y1, uint16_t x2, uint16_t y2, uint16_t x3, uint16_t y3, uint8_t color) {
/// Вывести закрашенный треугольник
/// \param x_1 - первая точка треугольника. Координата по оси "x"
/// \param y_1 - первая точка треугольника. Координата по оси "y"
/// \param x_2 - вторая точка треугольника. Координата по оси "x"
/// \param y_2 - вторая точка треугольника. Координата по оси "y"
/// \param x_3 - третья точка треугольника. Координата по оси "x"
/// \param y_3 - третья точка треугольника. Координата по оси "y"

#define ABS(x)   ((x) > 0 ? (x) : -(x))
	int16_t deltax = 0;
	int16_t deltay = 0;
	int16_t x = 0;
	int16_t y = 0;
	int16_t xinc1 = 0;
	int16_t xinc2 = 0;
	int16_t yinc1 = 0;
	int16_t yinc2 = 0;
	int16_t den = 0;
	int16_t num = 0;
	int16_t numadd = 0;
	int16_t numpixels = 0;
	int16_t curpixel = 0;

	deltax = ABS(x2 - x1);
	deltay = ABS(y2 - y1);
	x = x1;
	y = y1;

	if (x2 >= x1) {
		xinc1 = 1;
		xinc2 = 1;
	} else {
		xinc1 = -1;
		xinc2 = -1;
	}

	if (y2 >= y1) {
		yinc1 = 1;
		yinc2 = 1;
	} else {
		yinc1 = -1;
		yinc2 = -1;
	}

	if (deltax >= deltay) {
		xinc1 = 0;
		yinc2 = 0;
		den = deltax;
		num = deltax / 2;
		numadd = deltay;
		numpixels = deltax;
	} else {
		xinc2 = 0;
		yinc1 = 0;
		den = deltay;
		num = deltay / 2;
		numadd = deltax;
		numpixels = deltay;
	}

	for (curpixel = 0; curpixel <= numpixels; curpixel++) {
		GMG12864_Draw_line(x, y, x3, y3, color);

		num += numadd;
		if (num >= den) {
			num -= den;
			x += xinc1;
			y += yinc1;
		}
		x += xinc2;
		y += yinc2;
	}
}
/*----------------------------------Вывести закрашенный треугольник--------------------------------*/

/********************************РАБОТА С ГЕОМЕТРИЧЕСКИМИ ФИГУРАМИ**********************************/
